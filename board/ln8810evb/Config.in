## board/ln8810evb/Config.in
```kconfig
config AOS_BOARD_LN8810EVB
    bool "LN8810EVB"
    select AOS_MCU_LN881X
    select AOS_COMP_KERNEL_INIT
    select AOS_COMP_NETMGR
    select AOS_COMP_NEWLIB_STUB
    select AOS_COMP_LWIP
    select AOS_COMP_YLOOP
    select AOS_COMP_CLI
    select AOS_COMP_FATFS
    help

if AOS_BOARD_LN8810EVB
# Configurations for board ln8810evb

# "BSP SUPPORT FEATURE"
config BSP_SUPPORT_WIFI
    bool
    default y

endif
```

## platform/mcu/ln88xx/Config.in
```kconfig
config AOS_MCU_LN881X
    bool
    select AOS_ARCH_ARMV7M
    select AOS_COMP_RHINO
    help
      driver & sdk for platform/mcu ln881x

if AOS_MCU_LN881X
# Configurations for mcu ln881x
endif
```
